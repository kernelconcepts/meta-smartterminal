## conf/layer.conf
```bitbake
# We have a conf and classes directory, append to BBPATH
BBPATH .= ":${LAYERDIR}"

# We have a recipes directory containing .bb and .bbappend files, add to BBFILES
BBFILES += "${LAYERDIR}/recipes*/*/*.bb \
            ${LAYERDIR}/recipes*/*/*.bbappend"

BBFILE_COLLECTIONS += "meta-smartterminal"
BBFILE_PATTERN_meta-smartterminal := "^${LAYERDIR}/"
BBFILE_PRIORITY_meta-smartterminal = "9"

LAYERSERIES_COMPAT_meta-smartterminal = "sumo thud"

#The dynamic-layers directory hosts the extensions and layer specific
# modifications related to third party products.
#
# The .bbappend and .bb files are included if the respective layer
# collection is available.
BBFILES += "${@' '.join('${LAYERDIR}/dynamic-layers/%s/recipes*/*/*.bbappend' % layer \
	for layer in BBFILE_COLLECTIONS.split())}"
BBFILES += "${@' '.join('${LAYERDIR}/dynamic-layers/%s/recipes*/*/*.bb' % layer \
	for layer in BBFILE_COLLECTIONS.split())}"
```

## conf/machine/vdo-smartterminal.conf
```bitbake
#@TYPE: Machine
#@NAME: VDO SmartTerminal
#@DESCRIPTION: Machine configuration for the VDO SmartTerminal Based on RaspberryPi 3 Development Board

DEFAULTTUNE ?= "cortexa7thf-neon-vfpv4"
require conf/machine/include/arm/armv7a/tune-cortexa7.inc
include conf/machine/include/rpi-base.inc

MACHINE_FEATURES:append = "vc4graphics"
MACHINE_FEATURES:remove = "bluetooth"

MACHINE_EXTRA_RRECOMMENDS += "\
    linux-firmware-rpidistro-bcm43430 \
    linux-firmware-rpidistro-bcm43455 \
"

PREFERRED_VERSION_linux-raspberrypi = "6.6.%"

SDIMG_KERNELIMAGE ?= "kernel7.img"
UBOOT_MACHINE = "rpi_3_32b_config"
SERIAL_CONSOLES = ""

VC4DTBO = "vc4-kms-v3d"
ARMSTUB ?= "armstub7.bin"

SDIMG_ROOTFS_TYPE = "ext4"
IMAGE_FSTYPES = "ext4 wic wic.gz wic.bmap"

IMAGE_OVERHEAD_FACTOR = "1.4"
EXTRA_IMAGECMD:ext4="-i 1024"

WKS_FILE = "sdimage-vdo-smartterminal.wks"
IMAGE_BOOT_FILES:append = " boot_selection.scr"

RPI_KERNEL_DEVICETREE = " \
    broadcom/bcm2710-rpi-3-b.dtb \
    broadcom/bcm2710-rpi-3-b-plus.dtb \
    "

KERNEL_DEVICETREE = " \
    ${RPI_KERNEL_DEVICETREE} \
    ${RPI_KERNEL_DEVICETREE_OVERLAYS} \
     overlays/vdo-terminal-4-i2c-gpio.dtbo \
     overlays/vdo-terminal-4-i2c-rtc-gpio.dtbo \
     overlays/vdo-terminal-4-i2c-edt-ft5406-gpio.dtbo \
     overlays/vdo-terminal-4-pwm-2chan.dtbo \
     overlays/vdo-terminal-4-pwm-backlight.dtbo \
     overlays/vdo-terminal-4-dpi18.dtbo \
     overlays/vc4-kms-dpi-generic.dtbo \
     overlays/vc4-kms-dpi-panel.dtbo \
"

# Custom RPI specific config options
DISABLE_RPI_BOOT_LOGO = "1"
RPI_USE_U_BOOT = "1"
RPI_EXTRA_CONFIG = ' \n \
    # disable under-voltage warning \n \
    avoid_warnings=1 \n \
    # clock down GPU core \n \
    gpu_freq=250 \n \
    gpu_freq_min=250 \n \
    # backlight \n \
    dtparam=backlight-pwm=1,backlight-pwm-chan=1,backlight-pwm-gpio=19 \n \
    #avoid_safe_mode=1 \n \
    enable_uart=1 \n \
    boot_delay=0 \n \
    total_mem=1008 \n \
    # --- Software I2C --- \n \
    dtoverlay=vdo-terminal-4-i2c-gpio \n \
    \n \
    # --- I2C RTC --- \n \
    dtoverlay=vdo-terminal-4-i2c-rtc-gpio,mcp7940x \n \
    \n \
    # --- I2C Touch --- \n \
    # touch interrupt pin \n \
    gpio=10=ip \n \
    # touch reset pin \n \
    gpio=11=op,dh \n \
    # touch driver overlay \n \
    dtoverlay=vdo-terminal-4-i2c-edt-ft5406-gpio,edt-ft5x06 \n \
    \n \
    # --- Hardware PWM --- \n \
    dtparam=audio=off \n \
    dtoverlay=vdo-terminal-4-pwm-2chan \n \
    # PWM backlight \n \
    dtoverlay=vdo-terminal-4-pwm-backlight \n \
    \n \
    # --- Raspberry Pi 7\" display/touch screen --- \n \
    display_rotate=2 \n \
    # instead use video=DPI-1:800x480@60,rotate=180 \n \
    \n \
    # switch off blocks interfering with dpi display \n \
    dtparam=i2c_arm=off \n \
    dtparam=spi=off \n \
    dtparam=uart1=off \n \
    hdmi_blanking=2 \n \
    hdmi_ignore_edid=0xa5000080 \n \
    hdmi_ignore_hotplug=1 \n \
    hdmi_ignore_edid=1 \n \
    \n \
    # use 18bpp dpi overlay \n \
    dtoverlay=vdo-terminal-4-dpi18 \n \
    dtoverlay=vc4-kms-dpi-generic,rgb666-padhi \n \
    dtparam=hactive=800,hfp=210,hsync=2,hbp=0 \n \
    dtparam=vactive=480,vfp=22,vsync=2,vbp=0 \n \
    dtparam=clock-frequency=32000000 \n \
    #avoid_warnings=2 \n \
    \n \
    overscan_left=0 \n \
    overscan_right=0 \n \
    overscan_top=0 \n \
    overscan_bottom=0 \n \
    \n \
    framebuffer_width=800 \n \
    framebuffer_height=480 \n \
    \n \
    enable_dpi_lcd=1 \n \
    display_default_lcd=1 \n \
    \n \
    dpi_group=2 \n \
    dpi_mode=87 \n \
    dpi_output_format=0x6f016 \n \
    dpi_timings=800 0 210 2 0 480 0 22 2 0 0 0 0 50 0 32000000 3 \n \
    \n \
    # --- Devicetree debugging --- \n \
    dtdebug=1 \n \
    '
```
