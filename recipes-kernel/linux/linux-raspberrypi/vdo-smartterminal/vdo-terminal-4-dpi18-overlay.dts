/dts-v1/;
/plugin/;

/{
	compatible = "brcm,bcm2708";

	// There is no DPI driver module, but we need a platform device
	// node (that doesn't already use pinctrl) to hang the pinctrl
	// reference on - leds will do

        fragment@0 {
                target = <&dpi>;
                __overlay__  {
                        status = "okay";

                        pinctrl-names = "default";
                        pinctrl-0 = <&dpi_18bit_cpadhi_gpio0>;

                        port {
                                dpi_out: endpoint {
                                        remote-endpoint = <&panel_in>;
                                };
                        };
                };
        };
};
